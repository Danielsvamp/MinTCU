#include "calibration_structs.h"

// Defined in src/cars/<car>/calibration_data.cpp (generated by tools/egs_cal_gen.py)
extern const bool CAL_GENERATED;
extern HydraulicCalibration HYDR_CAL;
extern MechanicalCalibration MECH_CAL;
extern TorqueConverterCalibration TCC_CAL;
extern const ShiftAlgorithmPack SHIFT_ALGO_CAL; // In flash (PROGMEM)

// Same sizes as the config app (EgsStoredCalibration element_size_bytes), so the generator
// and the structs cannot get out of step
static_assert(sizeof(HydraulicCalibration) == 182, "HydraulicCalibration layout changed");
static_assert(sizeof(MechanicalCalibration) == 207, "MechanicalCalibration layout changed");
static_assert(sizeof(TorqueConverterCalibration) == 52, "TorqueConverterCalibration layout changed");
static_assert(sizeof(ShiftAlgorithmPack) == 672, "ShiftAlgorithmPack layout changed");

HydraulicCalibration* HYDR_PTR = &HYDR_CAL;
MechanicalCalibration* MECH_PTR = &MECH_CAL;
TorqueConverterCalibration* TCC_CFG_PTR = &TCC_CAL;
const ShiftAlgorithmPack* SHIFT_ALGO_CFG_PTR = &SHIFT_ALGO_CAL;

bool EGSCal::init_egs_calibration() {
    if (!CAL_GENERATED) {
        return false;
    }
    // Guard against zeroed mechanical CAL (Same as UN52)
    const uint16_t* r_table = MECH_PTR->ratio_table;
    if (r_table[1] == 0 || r_table[2] == 0  || r_table[3] == 0  || r_table[4] == 0  || r_table[5] == 0) {
        return false;
    }
    // The pressure path divides by these and searches the pcs map axes, so they must be sane
    if (0 == HYDR_PTR->p_multi_1 || 0 == HYDR_PTR->p_multi_other) {
        return false;
    }
    for (uint8_t i = 1; i < 7; i++) {
        if (HYDR_PTR->pcs_map_x[i] <= HYDR_PTR->pcs_map_x[i-1]) {
            return false;
        }
    }
    for (uint8_t i = 1; i < 4; i++) {
        if (HYDR_PTR->pcs_map_y[i] <= HYDR_PTR->pcs_map_y[i-1]) {
            return false;
        }
    }
    return true;
}
